## CMakeLists.txt
```
# SPDX-License-Identifier: Apache-2.0

cmake_minimum_required(VERSION 3.20.0)
find_package(Zephyr REQUIRED HINTS $ENV{ZEPHYR_BASE})
project(bbbled_app)

target_sources(app PRIVATE src/main.c)
```

## prj.conf
```kconfig
CONFIG_STDOUT_CONSOLE=y
CONFIG_USB_DEVICE_STACK=y
CONFIG_USB_DEVICE_PRODUCT="BBBLed Bluetooth Transmitter"
CONFIG_USB_DEVICE_PID=0x0001
CONFIG_LOG=y
CONFIG_USB_DRIVER_LOG_LEVEL_ERR=y
CONFIG_USB_DEVICE_LOG_LEVEL_ERR=y
CONFIG_SERIAL=y
CONFIG_UART_INTERRUPT_DRIVEN=y
CONFIG_UART_LINE_CTRL=y
CONFIG_USB_DEVICE_INITIALIZE_AT_BOOT=y
CONFIG_BASE64=y
CONFIG_CRC=y
CONFIG_MINIMAL_LIBC=y
CONFIG_SYS_CLOCK_TICKS_PER_SEC=1000
```

## src/main.c
```c
/*
 * Copyright (c) 2019 Intel Corporation
 *
 * SPDX-License-Identifier: Apache-2.0
 */

/**
 * @file
 * @brief Sample echo app for CDC ACM class
 *
 * Sample app for USB CDC ACM class driver. The received data is echoed back
 * to the serial port.
 */

#include <stdio.h>
#include <string.h>
#include <zephyr/device.h>
#include <zephyr/drivers/uart.h>
#include <zephyr/kernel.h>
#include <zephyr/sys/ring_buffer.h>

#include <zephyr/usb/usb_device.h>
#include <zephyr/usb/usbd.h>
#include <zephyr/logging/log.h>
LOG_MODULE_REGISTER(cdc_acm_echo, LOG_LEVEL_DBG);

const struct device *const uart_dev = DEVICE_DT_GET_ONE(zephyr_cdc_acm_uart);

#define RING_BUF_SIZE 1024
uint8_t ring_buffer[RING_BUF_SIZE];

struct ring_buf ringbuf;

static bool rx_throttled;

static inline void print_baudrate(const struct device *dev)
{
	uint32_t baudrate;
	int ret;

	ret = uart_line_ctrl_get(dev, UART_LINE_CTRL_BAUD_RATE, &baudrate);
	if (ret) {
		LOG_WRN("Failed to get baudrate, ret code %d", ret);
	} else {
		LOG_INF("Baudrate %u", baudrate);
	}
}

#if defined(CONFIG_USB_DEVICE_STACK_NEXT)
static struct usbd_context *sample_usbd;
K_SEM_DEFINE(dtr_sem, 0, 1);

static void sample_msg_cb(struct usbd_context *const ctx, const struct usbd_msg *msg)
{
	LOG_INF("USBD message: %s", usbd_msg_type_string(msg->type));

	if (usbd_can_detect_vbus(ctx)) {
		if (msg->type == USBD_MSG_VBUS_READY) {
			if (usbd_enable(ctx)) {
				LOG_ERR("Failed to enable device support");
			}
		}

		if (msg->type == USBD_MSG_VBUS_REMOVED) {
			if (usbd_disable(ctx)) {
				LOG_ERR("Failed to disable device support");
			}
		}
	}

	if (msg->type == USBD_MSG_CDC_ACM_CONTROL_LINE_STATE) {
		uint32_t dtr = 0U;

		uart_line_ctrl_get(msg->dev, UART_LINE_CTRL_DTR, &dtr);
		if (dtr) {
			k_sem_give(&dtr_sem);
		}
	}

	if (msg->type == USBD_MSG_CDC_ACM_LINE_CODING) {
		print_baudrate(msg->dev);
	}
}

static int enable_usb_device_next(void)
{
	int err;

	sample_usbd = sample_usbd_init_device(sample_msg_cb);
	if (sample_usbd == NULL) {
		LOG_ERR("Failed to initialize USB device");
		return -ENODEV;
	}

	if (!usbd_can_detect_vbus(sample_usbd)) {
		err = usbd_enable(sample_usbd);
		if (err) {
			LOG_ERR("Failed to enable device support");
			return err;
		}
	}

	LOG_INF("USB device support enabled");

	return 0;
}
#endif /* defined(CONFIG_USB_DEVICE_STACK_NEXT) */

static void interrupt_handler(const struct device *dev, void *user_data)
{
	ARG_UNUSED(user_data);

	while (uart_irq_update(dev) && uart_irq_is_pending(dev)) {
		if (!rx_throttled && uart_irq_rx_ready(dev)) {
			int recv_len, rb_len;
			uint8_t buffer[64];
			size_t len = MIN(ring_buf_space_get(&ringbuf),
					 sizeof(buffer));

			if (len == 0) {
				/* Throttle because ring buffer is full */
				uart_irq_rx_disable(dev);
				rx_throttled = true;
				continue;
			}

			recv_len = uart_fifo_read(dev, buffer, len);
			if (recv_len < 0) {
				LOG_ERR("Failed to read UART FIFO");
				recv_len = 0;
			};

			rb_len = ring_buf_put(&ringbuf, buffer, recv_len);
			if (rb_len < recv_len) {
				LOG_ERR("Drop %u bytes", recv_len - rb_len);
			}

			LOG_DBG("tty fifo -> ringbuf %d bytes", rb_len);
			if (rb_len) {
				uart_irq_tx_enable(dev);
			}
		}

		if (uart_irq_tx_ready(dev)) {
			uint8_t buffer[64];
			int rb_len, send_len;

			rb_len = ring_buf_get(&ringbuf, buffer, sizeof(buffer));
			if (!rb_len) {
				LOG_DBG("Ring buffer empty, disable TX IRQ");
				uart_irq_tx_disable(dev);
				continue;
			}

			if (rx_throttled) {
				uart_irq_rx_enable(dev);
				rx_throttled = false;
			}

			send_len = uart_fifo_fill(dev, buffer, rb_len);
			if (send_len < rb_len) {
				LOG_ERR("Drop %d bytes", rb_len - send_len);
			}

			LOG_DBG("ringbuf -> tty fifo %d bytes", send_len);
		}
	}
}

int main(void)
{
	int ret;

// 	if (!device_is_ready(uart_dev)) {
// 		LOG_ERR("CDC ACM device not ready");
// 		return 0;
// 	}

// #if defined(CONFIG_USB_DEVICE_STACK_NEXT)
// 		ret = enable_usb_device_next();
// #else
// 		ret = usb_enable(NULL);
// #endif

// 	if (ret != 0) {
// 		LOG_ERR("Failed to enable USB");
// 		return 0;
// 	}

	LOG_INF("USB device enabled");

// 	ring_buf_init(&ringbuf, sizeof(ring_buffer), ring_buffer);

// 	LOG_INF("Wait for DTR");

// #if defined(CONFIG_USB_DEVICE_STACK_NEXT)
// 	k_sem_take(&dtr_sem, K_FOREVER);
// #else
// 	while (true) {
// 		uint32_t dtr = 0U;

// 		uart_line_ctrl_get(uart_dev, UART_LINE_CTRL_DTR, &dtr);
// 		if (dtr) {
// 			break;
// 		} else {
// 			/* Give CPU resources to low priority threads. */
// 			k_sleep(K_MSEC(100));
// 		}
// 	}
// #endif

// 	LOG_INF("DTR set");

// 	/* They are optional, we use them to test the interrupt endpoint */
// 	ret = uart_line_ctrl_set(uart_dev, UART_LINE_CTRL_DCD, 1);
// 	if (ret) {
// 		LOG_WRN("Failed to set DCD, ret code %d", ret);
// 	}

// 	ret = uart_line_ctrl_set(uart_dev, UART_LINE_CTRL_DSR, 1);
// 	if (ret) {
// 		LOG_WRN("Failed to set DSR, ret code %d", ret);
// 	}

// 	/* Wait 100ms for the host to do all settings */
// 	k_msleep(100);

// #ifndef CONFIG_USB_DEVICE_STACK_NEXT
// 	print_baudrate(uart_dev);
// #endif
// 	uart_irq_callback_set(uart_dev, interrupt_handler);

// 	/* Enable rx interrupts */
// 	uart_irq_rx_enable(uart_dev);

	return 0;
}
```

## src/b64.c
```c
#include <stddef.h>
#include <stdint.h>
#include "b64.h"

LOG_MODULE_REGISTER(BBBLED_B64, LOG_LEVEL_INF);

int b64_encode(uint8_t *dest, const uint8_t* source)
{
    size_t written;
    int ret;

    ret = base64_encode(dest, sizeof(dest), &written, source, sizeof(source));

    if (ret != 0) {
        LOG_ERR("Base64 encoding failed with error %d", ret);
    }

    return ret;
}

int b64_decode(uint8_t *dest, const uint8_t* source)
{
    size_t written;
    int ret;

    ret = base64_decode(dest, sizeof(dest), &written, source, sizeof(source));

    if (ret != 0) {
        LOG_ERR("Base64 decoding failed with error %d", ret);
    }

    return ret;
}
```

## src/b64.h
```c
#ifndef BBBLED_B64_H
#define BBBLED_B64_H

#include <zephyr/sys/base64.h>
#include <stdint.h>

#ifdef __cplusplus
extern "C" {
#endif

int b64_encode(uint8_t *dest, const uint8_t* source);

int b64_decode(uint8_t *dest, const uint8_t* source);

#ifdef __cplusplus
}
#endif


#endif // BBBLED_B64_H
```

## src/commands.c
```c
#include "commands.h"
#include <zephyr/sys/util.h>
#include <string.h>
#include <zephyr/kernel.h>
#include <stdlib.h>

/**
 * Global array of str/enum values for all the accepted commands
 */
static const command_t valid_commands_enum[] = {
    COMMAND_SET_RGB,
    COMMAND_ACK,
    COMMAND_NACK,
};
static const char *valid_commands_str[] = {
    "set_rgb",
    "ack",
    "nack",
};


/**
 * Global arrays of str/enum values for all the accepted keys
 */
static const key_t valid_keys_enum[] = {
    KEY_RED,
    KEY_GREEN,
    KEY_BLUE,
    KEY_MSGNUM,
};
static const char *valid_keys_str[] = {
    "red",
    "green",
    "blue",
    "msg",
};


/**
 * Which specific keys are valid for which command
 */
static const key_t valid_keys_set_rgb[] = {
    SETRGB_RED,
    SETRGB_GREEN,
    SETRGB_BLUE,
};

static const key_t valid_keys_ack_nack[] = {
    KEY_MSGNUM,
};


command_t cmd_to_enum(char *str)
{
    command_t command = COMMAND_INVALID;
    for (int i = 0; i < NUM_COMMANDS; ++i)
    {
        if (strcmp(valid_commands_str[i], str) == 0)
        {
            command = i;
            return command;
        }
    }
    return command;
}

key_t key_to_enum(char *str)
{
    key_t key = KEY_INVALID;
    for (int i = 0; i < NUM_KEYS; ++i)
    {
        if (strcmp(valid_keys_str[i], str) == 0)
        {
            key = i;
            return key;
        }
    }
    return key;
}

char* cmd_to_string (command_t command)
{
    switch (command)
    {
        case COMMAND_SET_RGB:
            return "set_rgb";
        case COMMAND_ACK:
            return "ack";
        case COMMAND_NACK:
            return "nack";
        default:
            return NULL;
    }
}

char* key_to_string(key_t key)
{
    switch (key)
    {
        case KEY_RED:
            return "red";
        case KEY_GREEN:
            return "green";
        case KEY_BLUE:
            return "blue";
        case KEY_MSGNUM:
            return "msg";
        default:
            __ASSERT(0, "unreachable");
    }
}

value_t str_to_value(char *str)
{
    char *ptr;
    return (value_t) strtol(str, &ptr, 10);
}

void value_to_str(value_t value, char *dest, size_t size)
{
    snprintf(dest, size, "%d", value);
}

static int validate_kv_set_rgb(key_t key, value_t value)
{
    set_rgb_keys_t param = (set_rgb_keys_t) key;

    switch (param)
    {
        case SETRGB_RED:
        case SETRGB_GREEN:
        case SETRGB_BLUE:
            return (value > UINT8_MAX || value < 0);
        default:
            return -1;

    }
}

/**
 * @brief   Given a command, make sure that the params we have
 *          been given make sense.
 *
 * @param   command :   command to evaluate against
 * @param   key     :   key to evaluate
 * @param   value   :   value to evaluate
 *
 * @retval  0 if params are valid
 * @retval  1 if not
 */
int validate_param_for_command(
    command_t command,
    key_t key,
    value_t value)
{
    switch (command)
    {
        case COMMAND_SET_RGB:
            return validate_kv_set_rgb(key, value);
        case COMMAND_ACK:
        case COMMAND_NACK:
            return 1;
        case NUM_COMMANDS:
        case COMMAND_INVALID:
            return 1;
        default:
            __ASSERT(0, "unreachable");
    }
}
```

## src/commands.h
```c
#ifndef _BBBLED_COMMANDS_H
#define _BBBLED_COMMANDS_H
#include <stdio.h>
#include <zephyr/types.h>

#ifdef __cplusplus
extern "C" {
#endif

typedef enum {
    COMMAND_SET_RGB = 0,
    COMMAND_ACK,
    COMMAND_NACK,
    NUM_COMMANDS,
    COMMAND_INVALID,
} command_t;

typedef enum {
    SETRGB_RED = 0,
    SETRGB_GREEN,
    SETRGB_BLUE
} set_rgb_keys_t;

typedef enum {
    KEY_RED = 0,
    KEY_GREEN,
    KEY_BLUE,
    KEY_MSGNUM,
    NUM_KEYS,
    KEY_INVALID,
} key_t;

typedef uint16_t value_t;

/* kv pair definition */
struct key_val_pair{
    key_t key;
    value_t value;
};

key_t key_to_enum(char *str);
command_t cmd_to_enum(char *str);
char* key_to_string(key_t key);
char* cmd_to_string(command_t command);
value_t str_to_value(char *str);
int validate_param_for_command(command_t command, key_t key, value_t value);

#ifdef __cplusplus
}
#endif

#endif /* _BBBLED_COMMANDS_H */
```

## src/protocol.c
```c
#include <errno.h>
#include <zephyr/random/random.h>
#include <string.h>
#include <stdio.h>
#include <zephyr/sys/crc.h>
#include <zephyr/logging/log.h>
#include <stdlib.h>

#include "protocol.h"

#define PKT_SLAB_BLOCK_SIZE         sizeof(struct protocol_pkt)
#define PKT_SLAB_BLOCK_COUNT        12
#define SLAB_ALIGNMENT              4
#define PKT_TIMEOUT_MSEC            100

#define PROTOCOL_MSG_IDENTIFIER     "msg"
#define PROTOCOL_PREAMBLE           "!"
#define PROTOCOL_KEY_VALUE_SEP      ":"
#define PROTOCOL_ITEM_SEP           ","
#define PROTOCOL_CRC                "#"

K_MEM_SLAB_DEFINE(protocol_pkt_slab, PKT_SLAB_BLOCK_SIZE, PKT_SLAB_BLOCK_COUNT, SLAB_ALIGNMENT);

LOG_MODULE_REGISTER(bbbled_protocol, LOG_LEVEL_DBG);

/**
 * @brief   Construct an ACK for the given message number
 *
 * @param   msg_num :   Message number to ack
 *
 * @return  An ack packet.
 */
static inline const pkt_t create_ack(const uint16_t msg_num)
{
    return protocol_packet_create(COMMAND_ACK, NULL, 0, msg_num);
}

/**
 * @brief   Construct a NACK. The message number does not matter.
 *
 * @return  A nack packet.
 */
static inline const pkt_t create_nack()
{
    return protocol_packet_create(COMMAND_NACK, NULL, 0, -1);
}

/**
 * @brief   Create a random 16-bit number
 * @return  A random 16-bit number
 */
static inline uint16_t create_msg_num(void)
{
    return sys_rand16_get();
}

// /**
//  * @brief   Calculate the required size a buffer should be for serialisation
//  *          of a protocol packet.
//  *
//  * @param   pkt :   The packet being serialised
//  * @returns The size required for a buffer
//  */
// const size_t calc_rq_buf_size(
//     struct protocol_pkt *pkt)
// {
//     size_t command_len = strlen(pkt->command);

//     /*  '!' + "<command>" + ',' */
//     size_t size =
//         sizeof(PROTOCOL_PREAMBLE) +
//         (sizeof(char) * command_len) +
//         sizeof(uint8_t);


//     /*  "<key0>:<value0>,<key1>:<value1>,..." */
//     for (int i = 0; i < pkt->num_params; ++i)
//     {
//         size += (sizeof(char) * strlen(key_to_string(pkt->params[i].key)));
//         size += sizeof(uint8_t); // ':'
//         size += (sizeof(char) * strlen(valuepkt->params[i].value));
//         size += sizeof(uint8_t); // ','
//     }
//     size += (sizeof(char) * strlen(PROTOCOL_MSG_IDENTIFIER));
//     size += sizeof(uint8_t); // ':'
//     size += (sizeof(char) * PROTOCOL_MAX_MSG_NUM_CHARS); // worst case msg number length (16-bit decimal as char)
//     size += (sizeof(char) * 5); // #<CRC:04x>
//     size += sizeof(uint8_t); // '\0';

//     LOG_DBG("calculated size: %ld", size);
//     return size;
// }

size_t serialise_packet(
    pkt_t pkt,
    uint8_t *dest,
    size_t dest_size)
{
    struct serial_ctx ctx;

    serialise_ctx_init(&ctx, dest, dest_size, NULL);

    struct kv_pair_adapter adapter = {
        .pairs = pkt->params,
        .num_pairs = pkt->num_params,
        .pair_separator = PROTOCOL_KEY_VALUE_SEP,
        .pair_terminator = PROTOCOL_ITEM_SEP
    };

    struct serial_registry reg[] = {
        {.handler = serialise_padding_char,     .user_data = PROTOCOL_PREAMBLE},
        {.handler = serialise_str,              .user_data = cmd_to_string(pkt->command)},
        {.handler = serialise_padding_char,     .user_data = PROTOCOL_ITEM_SEP},
        {.handler = serialise_key_value_pairs,  .user_data = &adapter},
        {.handler = serialise_str,              .user_data = key_to_string(KEY_MSGNUM)},
        {.handler = serialise_padding_char,     .user_data = PROTOCOL_KEY_VALUE_SEP},
        {.handler = serialise_uint16t_dec,      .user_data = &pkt->msg_num},
        {.handler = serialise_padding_char,     .user_data = PROTOCOL_CRC},
    };

    serialise_handler_register(&ctx, reg, ARRAY_SIZE(reg));

    serialise(&ctx);

    /* CRC afterwards */
    crc_t crc = crc16_ccitt(PROTOCOL_CRC_POLY, ctx.buffer, ctx.bytes_written);
    serialise_uint16t_hex(&ctx, &crc);

    LOG_INF("Serialised packet, data=%s", dest);

    return ctx.bytes_written;
}

/**
 * @brief Verify the CRC of a packet
 *
 * @param   bytes   :   bytes to verify
 * @param   len     :   length of the bytes
 *
 * @return  0 if the CRC is valid, -1 if it is not
 */
static int verify_crc(const uint8_t* bytes, size_t len)
{
    const uint8_t *crc_start;
    crc_t crc;
    size_t data_len;
    uint8_t index = 0;

    crc_start = bytes;

    /* Find where the CRC starts */
    while (*crc_start++ != '#')
    {
        if (index++ == len) break;
    };

    if (index >= len)
    {
        LOG_WRN("could not find a crc");
        return 1;
    }

    /* convert to int */
    crc = (crc_t) strtol(crc_start, NULL, 16);
    data_len = (crc_start - bytes);

    LOG_DBG("got crc %04x, expected %04x", crc, crc16_ccitt(PROTOCOL_CRC_POLY, bytes, data_len));
    if (crc == crc16_ccitt(PROTOCOL_CRC_POLY, bytes, data_len))
    {
        return 0;
    }

    return -1;
}

/**
 * @brief   Given a string, populate an array with comma-separated tokens
 *
 * @param   str         string to examine
 * @param   len         size of the string
 * @param   token_array array to populate
 *
 * @retval  The number of tokens in the array
 */
static uint8_t tokeniser(char *str, size_t len, char token_array[][PROTOCOL_MAX_TOKEN_LEN])
{
    uint8_t index;
    char *search_char = PROTOCOL_ITEM_SEP;
    char *start_token;
    char *end_token;

    for (index = 0; index < PROTOCOL_MAX_NUM_TOKENS; ++index)
    {
        if (strstr(str, search_char) == NULL)
        {
            if (strstr(str, PROTOCOL_CRC) == NULL)
            {
                LOG_DBG("reached end of input");
                break;
            }
            else
            {
                search_char = PROTOCOL_CRC;
            }
        }

        start_token = str;
        end_token = strstr((str), search_char);
        size_t token_len = LEN(end_token, start_token);

        if (token_len >= PROTOCOL_MAX_TOKEN_LEN)
        {
            LOG_WRN("token too large [%ld bytes] - skipping", (token_len));
        }
        else
        {
            /*  copy the token into the array and null terminate it */
            memcpy(token_array[index], start_token, (token_len));
            token_array[index][token_len] = '\0';
        }

        /* Consume up to (and including) the next search character */
        str = strstr(str, search_char);
        str++;
    }

    return index;
}

int parse(
    char *str,
    size_t len,
    parsed_data_t data,
    uint16_t *msg_num)
{
    command_t command = COMMAND_INVALID;
    char token_array[PROTOCOL_MAX_NUM_TOKENS][PROTOCOL_MAX_TOKEN_LEN] = {0};
    uint8_t pair_index = 0;
    uint8_t num_tokens = 0;
    uint8_t invalid_params = 0;

    if (str == NULL)
    {
        return -1;
    }

    char id = *str;
    if (id != *PROTOCOL_PREAMBLE)
    {
        LOG_WRN("preamble not found");
        return -1;
    }

    if (verify_crc(str, len))
    {
        LOG_WRN("invalid crc");
        return -1;
    }

    /*  Convert the received bytes into string tokens
        Containing command, params and message number.
        Increment the pointer by one beforehand, we dont
        want the '!' included */
    num_tokens = tokeniser((char*) (str + 1), len - 1, token_array);


    command = cmd_to_enum(token_array[0]);

    /*  Check the command is valid */
    if (command == COMMAND_INVALID)
    {
        LOG_ERR("command invalid");
        return -1;
    }

    /*  We have a valid command, now iterate and
        validate the key:value sent with this
        command */
    for (uint8_t index = 1; index < num_tokens; ++index)
    {
        /*  Find the pointer to the separator */
        char *key_end = strstr(token_array[index], PROTOCOL_KEY_VALUE_SEP);

        if (key_end)
        {
            char *val_start;
            char* val_end;
            struct key_val_pair pair;
            size_t key_len = LEN(key_end, token_array[index]);
            char key_str[PROTOCOL_MAX_KEY_LEN];
            char value_str[PROTOCOL_MAX_KEY_LEN];

            /*  Copy and null-terminate the value */
            memcpy(key_str, token_array[index], (key_len));
            key_str[key_len] = '\0';
            pair.key = key_to_enum(key_str);


            /*  Copy the key */
            val_start = key_end + 1;

            /*  assume the end of the token has been null-terminated
                (should be done in the tokeniser)*/
            while (*key_end++ != '\0');
            val_end = key_end;
            memcpy(value_str, val_start, LEN(val_end, val_start));
            pair.value = str_to_value(value_str);

            /*  Validate the params and get the msg number
                if one has been supplied */
            if (strcmp(key_str, PROTOCOL_MSG_IDENTIFIER) == 0)
            {
                *msg_num = pair.value;
            }
            else if (validate_param_for_command(command, pair.key, pair.value) == 0)
            {
                data->params[pair_index] = pair;
                ++pair_index;
            }
            else
            {
                LOG_WRN("invalid param [%s:%s]", pair.key, pair.value);
                invalid_params = 1;
            }
        }
        else
        {
            break;
        }
    }
    data->command = command;
    data->num_params = pair_index;

    if (*msg_num == -1)
    {
        return -1;
    }

    if (invalid_params)
    {
        return -1;
    }

    return PARSER_OK;
}

static void remove_packet(protocol_ctx_t ctx, const uint16_t msg_num)
{
    if (ctx->to_send && ctx->to_send->msg_num == msg_num)
    {
        timer_stop(ctx->resend_timer);
        k_mem_slab_free(&protocol_pkt_slab, ctx->to_send);
        ctx->to_send = NULL;
    }
}

inline void queue_packet(protocol_ctx_t ctx, const pkt_t pkt)
{
    if (ctx->to_send == NULL)
    {
        ctx->to_send = pkt;
    }
}

static inline void mark_packet_for_resend(protocol_ctx_t ctx)
{
    ctx->to_send->resend = true;
}

inline pkt_t send_pkt(protocol_ctx_t ctx)
{
    timer_start(ctx->resend_timer, K_MSEC(PKT_TIMEOUT_MSEC), K_MSEC(PKT_TIMEOUT_MSEC));
    return ctx->to_send;
}

void handle_incoming(
    protocol_ctx_t ctx,
    parsed_data_t data)
{
    __ASSERT(ctx, "Invalid ctx ptr");
    __ASSERT(data, "Invalid data ptr");
    int16_t msg_num = -1;

    int ret = parse((char*) ctx->rx_buf, ctx->rx_len, data, &msg_num);
    if (ret)
    {
        LOG_ERR("Parsing failed");
        queue_packet(ctx, create_nack());
        return;
    }

    switch (data->command)
    {
        case COMMAND_SET_RGB:
            remove_packet(ctx, msg_num);
            queue_packet(ctx, create_ack(msg_num));
            break;
        case COMMAND_ACK:
            remove_packet(ctx, msg_num);
            break;
        case COMMAND_NACK:
            mark_packet_for_resend(ctx);
            break;
        case COMMAND_INVALID:
            queue_packet(ctx, create_nack());
            break;
    }
}

pkt_t protocol_packet_create(
    command_t command,
    struct key_val_pair params[],
    size_t num_params,
    uint16_t msg_num)
{
    pkt_t pkt;

    /*  First validate params */
    for (uint8_t index = 0; index < num_params; ++index)
    {
        if (validate_param_for_command(command, params[index].key, params[index].value)) return NULL;
    }

    /*  Then allocate memory */
    int rc = k_mem_slab_alloc(&protocol_pkt_slab, (void **)&pkt, K_FOREVER);
    if (rc)
    {
        LOG_ERR("slab memory allocation failed");
        return NULL;
    }

    memset(pkt, 0, sizeof(struct protocol_pkt));

    /*  Now we can populate the packet */
    for (uint8_t index = 0; index < num_params; ++index)
    {
        pkt->params[index] = params[index];
    }
    pkt->command = command;
    pkt->num_params = num_params;

    /*  If no message number has been given, generate one */
    if (msg_num == -1)
    {
        pkt->msg_num = create_msg_num();
    }
    else
    {
        pkt->msg_num = msg_num;
    }

    pkt->resend = false;

    return pkt;
}

static void resend_timer_expiry(timer_t *timer)
{
    protocol_ctx_t ctx = (protocol_ctx_t)timer->user_data;

    if (ctx->retry_attempts == PROTOCOL_MAX_MSG_RETRIES)
    {
        remove_packet(ctx, ctx->to_send->msg_num);
    }
    else
    {
        ctx->retry_attempts += 1;
        ctx->to_send->resend = true;
    }
}

void protocol_init(struct protocol_ctx *ctx, uint8_t *buffer, size_t buffer_size, timer_t *timer)
{
    protocol_ctx_t this = ctx;

    timer_init(timer, resend_timer_expiry, NULL, this);
    // this->resend_timer = timer;
    this->rx_buf = buffer;
    this->rx_len = buffer_size;
    this->to_send = NULL;
    this->retry_attempts = PROTOCOL_MAX_MSG_RETRIES;
}
```

## src/protocol.h
```c
#ifndef _BBBLED_PROTOCOL_H
#define _BBBLED_PROTOCOL_H

#include <zephyr/types.h>
#include <zephyr/kernel.h>
#include <zephyr/sys/ring_buffer.h>

#include "commands.h"
#include "serialise.h"
#include "timer.h"

#ifdef __cplusplus
extern "C" {
#endif

#define PROTOCOL_MAX_PARAMS 8
#define PROTOCOL_MAX_KEY_LEN 16
#define PROTOCOL_MAX_VALUE_LEN 16
#define PROTOCOL_MAX_MSG_RETRIES 5
#define PROTOCOL_CRC_POLY 0x0000 // CCITT poly
// max number of chars in msg:<number> identifier
#define PROTOCOL_MAX_MSG_NUM_CHARS 5
#define PROTOCOL_MAX_CMD_LEN 32
#define PROTOCOL_MAX_DATA_SIZE 305
#define PROTOCOL_RECV_BUF_SIZE 512
#define PROTOCOL_MAX_TOKEN_LEN MAX(PROTOCOL_MAX_CMD_LEN, (PROTOCOL_MAX_KEY_LEN + PROTOCOL_MAX_VALUE_LEN + 1))
// Maximum number of params + command and msg number
#define PROTOCOL_MAX_NUM_TOKENS (PROTOCOL_MAX_PARAMS + 2)
#define PROTOCOL_VALID_COMMANDS 1

/* Helpful macros */

// Find how many items are in an array
#define STATIC_STR_ARRAY_LEN(array) (sizeof(array) / sizeof(*array))

// Find the length between two pointers
#define LEN(end, start) ((end) - (start))

typedef enum {
    PARSER_OK = 0,
    PARSER_INVALID_BYTES,
    PARSER_INVALID_PREAMBLE,
    PARSER_INVALID_CRC,
    PARSER_INVALID_MSG_NUM,
    PARSER_INVALID_CMD,
    PARSER_INVALID_PARAMS,
} parser_ret_t;

typedef enum {
    SERIALISE_OK = 0,
    SERIALISE_NO_MEM,
    SERIALISE_INVALID_PKT,
    SERIALISE_EXCEED_PAIR_LEN,
    SERIALISE_EXCEED_MSG_LEN,
} serialise_ret_t;


typedef uint16_t crc_t;

enum pkt_type {
    PKT_TYPE_DATA = 1,
    PKT_TYPE_ACK,
    PKT_TYPE_NACK,
};

struct parsed_data{
    command_t command;
    struct key_val_pair params[PROTOCOL_MAX_PARAMS];
    size_t num_params;
};

typedef struct parsed_data* parsed_data_t;

/**
 * @brief Packet structure for the protocol. Each packet should include:
 * @param   command     :   the command being sent
 * @param   params      :   the key:value params that correspond to the command
 * @param   num_params  :   how many params we are sending
 * @param   msg_num     :   msg number for the pkt
 * @param   crc         :   the crc for the data
 * @param   resend      :   if the pkt is marked for resend
 */
struct protocol_pkt {
    command_t command;
    struct key_val_pair params[PROTOCOL_MAX_PARAMS];
    size_t num_params;
    uint16_t msg_num;
    crc_t crc; // CRC checksum for the message
    bool resend;
};

typedef struct protocol_pkt* pkt_t;

typedef void (*timer_cb_t)(timer_t*);

struct protocol_ctx {
    uint8_t *rx_buf;
    size_t rx_len;
    struct protocol_pkt *to_send;
    uint8_t retry_attempts;
    timer_t *resend_timer;
};

typedef struct protocol_ctx* protocol_ctx_t;


/**
 * @brief   Creates a new protocol packet and assigns it a
 *          msg number.
 *
 * @param   command        command to send
 * @param   params         parameters to send with the command
 * @param   num_params     number of parameters included
 * @param   msg_num        assign this msg number to the pkt
 * @retval  Ptr to pkt on success
 * @retval  NULL ptr on failure
 */
pkt_t protocol_packet_create(command_t command, struct key_val_pair *params, size_t num_params, uint16_t msg_num);

/**
 * @brief Convert a packet to a string
 *
 * @param   pkt         packet to convert
 * @param   dest        buffer to copy into
 * @param   dest_size   size of buffer
 *
 * @returns Amount of bytes written to the buffer
 *
 */
size_t serialise_packet(struct protocol_pkt *pkt, uint8_t *dest, size_t dest_size);

/**
 * @brief Create a new protocol context
 *
 * @param   ctx         :   The empty context object
 * @param   buffer      :   Buffer pointer. Used for storing data received over the interface
 * @param   buffer_size :   Size of the buffer
 * @param   timer       :   Pointer to an uninitialised timer
 * @returns An initialised protocol context
 */
void protocol_init(
    protocol_ctx_t ctx,
    uint8_t *buffer,
    size_t buffer_size,
    timer_t *timer);

/**
 * @brief   parse a string, returning its command and params if valid
 *
 * @param   str     string to parse
 * @param   len     lenth of the string
 * @param   data    data to populate
 * @param   msg_num msg number for the parsed data
 *
 * @retval  -1 if failure
 * @retval  0 if successful
 */
int parse(
    char *str,
    size_t len,
    parsed_data_t data,
    uint16_t *msg_num);

void handle_incoming(
    protocol_ctx_t ctx,
    parsed_data_t data);




#ifdef __cplusplus
}
#endif

#endif /* _BBBLED_PROTOCOL_H */
```

## src/serialise.c
```c
#include "serialise.h"
#include <string.h>
#include <stdio.h>
#include <zephyr/logging/log.h>

#define STR_SIZE_16BIT_UINT 6
#define STR_SIZE_16BIT_HEX 5

LOG_MODULE_REGISTER(serialise, LOG_LEVEL_DBG);

typedef struct {
    serialise_handler_t handler;
    void *user_data;
} serialise_cb_t;

static serialise_cb_t _cb_array[SERIALISE_CALLBACKS_MAX];
static volatile uint8_t cb_index = 0;


void write_to_buffer(uint8_t *dest, uint8_t *src, size_t *written, size_t amount)
{
    memcpy(dest, src, amount);
    *written += amount;
}

void serialise_padding_char(serial_ctx_t ctx, void *data)
{
    char *c = (char*)data;

    write_to_buffer(ctx->buffer + ctx->bytes_written, c, &ctx->bytes_written, 1);
}

void serialise_uint16t_dec(serial_ctx_t ctx, void *data)
{
    uint16_t dec = *(uint16_t*)data;

    char dec_str[STR_SIZE_16BIT_UINT] = {0};

    int written = snprintf(dec_str, STR_SIZE_16BIT_UINT, "%d", dec);
    write_to_buffer(ctx->buffer + ctx->bytes_written, dec_str, &ctx->bytes_written, written);
}

void serialise_uint16t_hex(serial_ctx_t ctx, void *data)
{
    uint16_t hex = *(uint16_t*)data;
    char hex_str[STR_SIZE_16BIT_HEX] = {0};

    int written = snprintf(hex_str, STR_SIZE_16BIT_HEX, "%04x", hex);
    write_to_buffer(ctx->buffer + ctx->bytes_written, hex_str, &ctx->bytes_written, written);
}

void serialise_str(serial_ctx_t ctx, void *data)
{
    char *str = (char*)data;

    write_to_buffer(ctx->buffer + ctx->bytes_written, str, &ctx->bytes_written, strlen(str));
}

void serialise_handler_register(serial_ctx_t ctx, struct serial_registry *reg, size_t reg_size)
{
    ctx->max_cb_index = reg_size;

    for (uint8_t index = 0; index < ctx->max_cb_index; ++index)
    {
        serialise_cb_t *cb = &(_cb_array[index]);
        cb->handler = reg[index].handler;
        cb->user_data = reg[index].user_data;
    }
}

void serialise(serial_ctx_t ctx)
{
    for (uint8_t index = 0; index < ctx->max_cb_index; ++index)
    {
        serialise_cb_t *cb = &(_cb_array[index]);
        cb->handler(ctx, cb->user_data);
    }
    memset(_cb_array, 0, SERIALISE_CALLBACKS_MAX);
}

void serialise_key_value_pairs(serial_ctx_t ctx, void *data)
{
    kv_pair_adapter_t adapter = (kv_pair_adapter_t) data;

    for (uint8_t index = 0; index < adapter->num_pairs; ++index)
    {
        serialise_str(ctx, key_to_string(adapter->pairs[index].key));
        serialise_padding_char(ctx, adapter->pair_separator);
        serialise_uint16t_dec(ctx, &adapter->pairs[index].value);
        serialise_padding_char(ctx, adapter->pair_terminator);
    }
}

serial_ctx_t serialise_ctx_init(struct serial_ctx *ctx, uint8_t *buffer, size_t buffer_size, void *user_data)
{
    serial_ctx_t this = ctx;

    this->buffer = buffer;
    this->buffer_size = buffer_size;
    this->bytes_written = 0;
    this->user_data = user_data;
    this->max_cb_index = 0;

    return this;
}
```

## src/serialise.h
```c
#ifndef _BBBLED_SERIALISE_H
#define _BBBLED_SERIALISE_H

#include <zephyr/types.h>
#include "commands.h"

#ifdef __cplusplus
extern "C" {
#endif

#define SERIALISE_CALLBACKS_MAX UINT8_MAX

/* Serialiser context object definitions */
struct serial_ctx {
    uint8_t *buffer;
    size_t bytes_written;
    size_t buffer_size;
    void *user_data;
    uint8_t max_cb_index;
};

typedef struct serial_ctx* serial_ctx_t;
/* Signature for a serialiser handler */
typedef void (*serialise_handler_t)(serial_ctx_t, void*);

struct serial_registry {
    serialise_handler_t handler;
    void *user_data;
};

/* Adapt the args for serialising kv pairs*/
struct kv_pair_adapter {
    struct key_val_pair *pairs;
    uint8_t num_pairs;
    char *pair_separator;
    char *pair_terminator;
};
typedef struct kv_pair_adapter* kv_pair_adapter_t;

/* public functions */

void serialise_padding_char(serial_ctx_t ctx, void *data);
void serialise_uint16t_dec(serial_ctx_t ctx, void *data);
void serialise_uint16t_hex(serial_ctx_t ctx, void *data);
void serialise_str(serial_ctx_t ctx, void *data);
void serialise_handler_register(serial_ctx_t ctx, struct serial_registry *reg, size_t reg_size);
void serialise_key_value_pairs(serial_ctx_t ctx, void *data);
void serialise(serial_ctx_t ctx);
serial_ctx_t serialise_ctx_init(struct serial_ctx *ctx, uint8_t *buffer, size_t buffer_size, void *user_data);

#ifdef __cplusplus
}
#endif

#endif /* _BBBLED_SERIALISE_H */
```

## src/timer.c
```c
#include "timer.h"


void timer_init(timer_t *timer, timer_expiry_cb_t expiry_fn, timer_stop_cb_t stop_fn, void *data)
{
    k_timer_init(timer, expiry_fn, stop_fn);
    k_timer_user_data_set(timer, data);
}

void timer_start(timer_t *timer, timeout_t duration, timeout_t period)
{
    k_timer_start(timer, duration, period);
}

void timer_stop(timer_t *timer)
{
    k_timer_stop(timer);
}
```

## src/timer.h
```c
#ifndef _BBBLED_TIMER_H
#define _BBBLED_TIMER_H

#include <zephyr/kernel.h>

#ifdef __cplusplus
extern "C" {
#endif

typedef struct k_timer timer_t;
typedef k_timeout_t timeout_t;

typedef k_timer_expiry_t timer_expiry_cb_t;
typedef k_timer_stop_t  timer_stop_cb_t;

void timer_init(timer_t *timer, timer_expiry_cb_t expiry_fn, timer_stop_cb_t stop_fn, void *data);

void timer_start(timer_t *timer, timeout_t duration, timeout_t period);

void timer_stop(timer_t *timer);


#ifdef __cplusplus
}
#endif

#endif /* _BBBLED_TIMER_H */
```
